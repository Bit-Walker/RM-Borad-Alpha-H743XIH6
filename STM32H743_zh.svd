# STM32H743 register map
File version: 2.4
CPU: CM7 r0p1, little endian, MPU, FPU, 4 interrupt priority bits
Registers are 32-bit, read-write, reset 0x0 unless marked. A register's access mark holds for its fields unless they carry their own. Offsets are from the block's base; lines under a group give offsets from that group; [hi:lo] are bit positions; {n}, {i} and the like mark numbered series; 'fields as' and 'values as' point back to an identical list; <NAME> marks a mode.

## Memory map
0x40000000 TIM2 size 0x400 — 通用定时器
0x40000400 TIM3 size 0x400
0x40000800 TIM4 size 0x400
0x40000C00 TIM5 size 0x400
0x40001000 TIM6 size 0x400 — 基本定时器
0x40001400 TIM7 size 0x400
0x40001800 TIM12 size 0x400
0x40001C00 TIM13 size 0x400
0x40002000 TIM14 size 0x400
0x40002400 LPTIM1 size 0x400 — 低功耗定时器
0x40003800 SPI2 size 0x400
0x40003C00 SPI3 size 0x400
0x40004000 SPDIFRX size 0x400 — S/PDIF 接收器接口
0x40004400 USART2 size 0x400
0x40004800 USART3 size 0x400
0x40004C00 UART4 size 0x400
0x40005000 UART5 size 0x400
0x40005400 I2C1 size 0x400 — I2C 总线接口
0x40005800 I2C2 size 0x400
0x40005C00 I2C3 size 0x400
0x40006C00 CEC size 0x400 — HDMI-CEC 控制器
0x40007400 DAC size 0x400 — 数模转换器（DAC）
0x40007800 UART7 size 0x400
0x40007C00 UART8 size 0x400
0x40008400 CRS size 0x400
0x40008800 SWPMI size 0x400 — 单线协议主接口
0x40009000 OPAMP size 0x400 — 运算放大器
0x40009400 MDIOS size 0x400 — 管理数据输入/输出从机接口
0x4000A000 FDCAN1 size 0x400
0x4000A400 FDCAN2 size 0x400
0x4000A800 CAN_CCU size 0x400 — 时钟校准单元（CCU）寄存器
0x40010000 TIM1 size 0x400 — 高级控制定时器
0x40010400 TIM8 size 0x400
0x40011000 USART1 size 0x400 — 通用同步异步收发器
0x40011400 USART6 size 0x400
0x40013000 SPI1 size 0x400 — 串行外设接口
0x40013400 SPI4 size 0x400
0x40014000 TIM15 size 0x400 — 通用定时器
0x40014400 TIM16 size 0x400 — 通用定时器
0x40014800 TIM17 size 0x400 — 通用定时器
0x40015000 SPI5 size 0x400
0x40015800 SAI1 size 0x400
0x40015C00 SAI2 size 0x400
0x40016000 SAI3 size 0x400
0x40017000 DFSDM size 0x400 — Sigma-Delta 调制器数字滤波器
0x40017400 HRTIM_Master size 0x80 — 高分辨率定时器：主定时器
0x40017480 HRTIM_TIMA size 0x80 — 高分辨率定时器：TIMA
0x40017500 HRTIM_TIMB size 0x80 — 高分辨率定时器：TIMB
0x40017580 HRTIM_TIMC size 0x80 — 高分辨率定时器：TIMC
0x40017600 HRTIM_TIMD size 0x80 — 高分辨率定时器：TIMD
0x40017680 HRTIM_TIME size 0x80 — 高分辨率定时器 E 通道
0x40017780 HRTIM_Common size 0x80 — 高分辨率定时器：通用功能
0x40020000 DMA1 size 0x400 — DMA 控制器
0x40020400 DMA2 size 0x400
0x40020800 DMAMUX1 size 0x400 — DMAMUX（DMA 请求复用器）
0x40022000 ADC1 size 0xD1
0x40022100 ADC2 size 0xD1
0x40022300 ADC12_Common size 0x100
0x40028000 Ethernet_MAC size 0xBDF — 以太网：介质访问控制（MAC）
0x40028C00 Ethernet_MTL size 0x200 — 以太网：MTL 模式寄存器（MTL）
0x40029000 Ethernet_DMA size 0x400 — 以太网：DMA 控制器
0x40040000 OTG1_HS_GLOBAL size 0x400 — USB 1 OTG 高速
0x40040400 OTG1_HS_HOST size 0x400 — USB 1 OTG 高速接口
0x40040800 OTG1_HS_DEVICE size 0x400 — USB 1 OTG 高速接口
0x40040E00 OTG1_HS_PWRCLK size 0x3F200 — USB 1 OTG 高速接口
0x40080000 OTG2_HS_GLOBAL size 0x400
0x40080400 OTG2_HS_HOST size 0x400
0x40080800 OTG2_HS_DEVICE size 0x400
0x40080E00 OTG2_HS_PWRCLK size 0x3F200
0x48020000 DCMI size 0x400 — 数字摄像头接口
0x48021800 RNG size 0x400 — 随机数发生器
0x48022400 SDMMC2 size 0x3FD
0x48022800 DELAY_Block_SDMMC2 size 0x8
0x48023000 RAMECC2 size 0x400 — ECC 控制器与各 RAM 区域相关联
0x50001000 LTDC size 0x1000 — LCD-TFT 控制器
0x50003000 WWDG size 0x400
0x51000000 AXI size 0x100000 — AXI 互连寄存器
0x52000000 MDMA size 0x1000 — MDMA（主 DMA 控制器）
0x52001000 DMA2D size 0x400 — DMA2D（Chrom-Art 2D DMA 加速器）
0x52002000 Flash size 0x1000 — 闪存控制器
0x52003000 JPEG size 0x400 — JPEG 编解码器
0x52004000 FMC size 0x400 — 灵活存储控制器（FMC）
0x52005000 QUADSPI size 0x400
0x52006000 DELAY_Block_QUADSPI size 0x8
0x52007000 SDMMC1 size 0x3FD
0x52008000 DELAY_Block_SDMMC1 size 0x8 — SDMMC1 延时模块
0x52009000 RAMECC1 size 0x400 — ECC 控制器关联到各 RAM 区域
0x58000000 EXTI size 0x400 — 外部中断/事件控制器
0x58000400 SYSCFG size 0x400 — 系统配置控制器
0x58000C00 LPUART1 size 0x400
0x58001400 SPI6 size 0x400
0x58001C00 I2C4 size 0x400
0x58002400 LPTIM2 size 0x400
0x58002800 LPTIM3 size 0x400 — 低功耗定时器
0x58002C00 LPTIM4 size 0x400
0x58003000 LPTIM5 size 0x400
0x58003800 COMP1 size 0x400 — 比较器 1
0x58003C00 VREFBUF size 0x400
0x58004000 RTC size 0x400
0x58004800 IWDG size 0x400 — 独立看门狗
0x58005400 SAI4 size 0x400 — 串行音频接口
0x58020000 GPIOA size 0x400 — 通用输入输出端口
0x58020400 GPIOB size 0x400
0x58020800 GPIOC size 0x400
0x58020C00 GPIOD size 0x400
0x58021000 GPIOE size 0x400
0x58021400 GPIOF size 0x400
0x58021800 GPIOG size 0x400
0x58021C00 GPIOH size 0x400
0x58022000 GPIOI size 0x400
0x58022400 GPIOJ size 0x400
0x58022800 GPIOK size 0x400
0x58024400 RCC size 0x400 — 复位与时钟控制
0x58024800 PWR size 0x400
0x58024C00 CRC size 0x400 — CRC 校验计算单元
0x58025400 BDMA size 0x400 — BDMA（基本 DMA 控制器）
0x58025800 DMAMUX2 size 0x400 — DMA 请求复用器
0x58026000 ADC3 size 0xD1 — 模数转换器
0x58026300 ADC3_Common size 0x100 — 模数转换器
0x58026400 HSEM size 0x400 — 硬件信号量（HSEM）
0x58027000 RAMECC3 size 0x400 — ECC 控制器与各 RAM 区域相关联
0x5C001000 DBGMCU size 0x400 — 微控制器调试单元

## Interrupts
0 WWDG1 (WWDG) — 窗口看门狗中断
1 PVD_PVM (EXTI) — 通过 EXTI 线的 PVD 中断
2 RTC_TAMP_STAMP_CSS_LSE (RTC) — RTC 入侵检测和时间戳中断
3 RTC_WKUP (RTC) — RTC 唤醒中断
4 FLASH (Flash) — 闪存存储器中断
5 RCC — RCC 全局中断
6 EXTI0 (EXTI) — EXTI 线 0 中断
7 EXTI1 (EXTI) — EXTI 线 1 中断
8 EXTI2 (EXTI) — EXTI 线 2 中断
9 EXTI3 (EXTI) — EXTI 线 3 中断
10 EXTI4 (EXTI) — EXTI 线 4 中断
11 DMA_STR0 (DMA1) — DMA1 流 0
12 DMA_STR1 (DMA1) — DMA1 流 1
13 DMA_STR2 (DMA2) — DMA1 Stream2
14 DMA_STR3 (DMA2) — DMA1 Stream3
15 DMA_STR4 (DMA2) — DMA1 Stream4
16 DMA_STR5 (DMA2) — DMA1 Stream5
17 DMA_STR6 (DMA2) — DMA1 Stream6
18 ADC1_2 (ADC1) — ADC1 and ADC2
19 FDCAN1_IT0 (FDCAN1) — FDCAN1 中断 0
20 FDCAN2_IT0 (FDCAN2) — FDCAN2 Interrupt 0
21 FDCAN1_IT1 (FDCAN1) — FDCAN1 中断 1
22 FDCAN2_IT1 (FDCAN2) — FDCAN2 Interrupt 1
23 EXTI9_5 (EXTI) — EXTI 线[9:5] 中断
24 TIM1_BRK (TIM1) — TIM1 刹车中断
25 TIM1_UP (TIM1) — TIM1 更新中断
26 TIM1_TRG_COM (TIM1) — TIM1 触发与换相中断
27 TIM_CC (TIM1) — TIM1 捕获/比较中断
28 TIM2 — TIM2 全局中断
29 TIM3 — TIM3 global interrupt
30 TIM4 — TIM4 global interrupt
31 I2C1_EV (I2C1) — I2C1 事件中断
32 I2C1_ER (I2C1) — I2C1 错误中断
33 I2C2_EV (I2C2) — I2C2 event interrupt
34 I2C2_ER (I2C2) — I2C2 error interrupt
35 SPI1 — SPI1 全局中断
36 SPI2 — SPI2 global interrupt
37 USART1 — USART1 全局中断
38 USART2 — USART2 global interrupt
39 USART3 — USART3 global interrupt
40 EXTI15_10 (EXTI) — EXTI 线[15:10] 中断
41 RTC_ALARM (RTC) — RTC 闹钟中断（A 和 B）
43 TIM8_BRK_TIM12 (TIM8) — TIM8 break and TIM12 global interrupts
44 TIM8_UP_TIM13 (TIM8) — TIM8 update and TIM13 global interrupts
45 TIM8_TRG_COM_TIM14 (TIM8) — TIM8 trigger /commutation and TIM14 global interrupts
46 TIM8_CC (TIM8) — TIM8 capture / compare
47 DMA1_STR7 (DMA1) — DMA1 流 7
48 FMC — FMC 全局中断
49 SDMMC1 — SDMMC 全局中断
50 TIM5 — TIM5 global interrupt
51 SPI3 — SPI3 global interrupt
52 UART4 — UART4 global interrupt
53 UART5 — UART5 global interrupt
54 TIM6_DAC (TIM6) — TIM6 全局中断
55 TIM7 — TIM7 global interrupt
56 DMA2_STR0 (DMA2) — DMA2 Stream0 interrupt
57 DMA2_STR1 (DMA2) — DMA2 Stream1 interrupt
58 DMA2_STR2 (DMA2) — DMA2 Stream2 interrupt
59 DMA2_STR3 (DMA2) — DMA2 Stream3 interrupt
60 DMA2_STR4 (DMA2) — DMA2 Stream4 interrupt
61 ETH (Ethernet_MAC) — 以太网全局中断
62 ETH_WKUP (Ethernet_MAC) — 以太网通过 EXTI 唤醒中断
63 FDCAN_CAL (FDCAN1) — CAN2TX 中断
68 DMA2_STR5 (DMA2) — DMA2 Stream5 interrupt
69 DMA2_STR6 (DMA2) — DMA2 Stream6 interrupt
70 DMA2_STR7 (DMA2) — DMA2 Stream7 interrupt
71 USART6 — USART6 global interrupt
72 I2C3_EV (I2C3) — I2C3 event interrupt
73 I2C3_ER (I2C3) — I2C3 error interrupt
74 OTG_HS_EP1_OUT (OTG1_HS_GLOBAL) — OTG_HS OUT 全局中断
75 OTG_HS_EP1_IN (OTG1_HS_GLOBAL) — OTG_HS IN 全局中断
76 OTG_HS_WKUP (OTG1_HS_GLOBAL) — OTG_HS 唤醒中断
77 OTG_HS (OTG1_HS_GLOBAL) — OTG_HS 全局中断
78 DCMI — DCMI 全局中断
80 HASH_RNG (RNG) — HASH 或 RNG 中断
81 FPU (EXTI) — CPU FPU 中断
82 UART7 — UART7 global interrupt
83 UART8 — UART8 global interrupt
84 SPI4 — SPI4 global interrupt
85 SPI5 — SPI5 global interrupt
86 SPI6 — SPI6 global interrupt
87 SAI1 — SAI1 global interrupt
88 LTDC — LCD-TFT 全局中断
89 LTDC_ER (LTDC) — LCD-TFT 错误中断
90 DMA2D — DMA2D 全局中断
91 SAI2 — SAI2 global interrupt
92 QUADSPI — QuadSPI 全局中断
93 LPTIM1 — LPTIM1 全局中断
94 CEC — HDMI-CEC 全局中断
95 I2C4_EV (I2C4) — I2C4 event interrupt
96 I2C4_ER (I2C4) — I2C4 error interrupt
97 SPDIF (SPDIFRX) — SPDIFRX 全局中断
98 OTG_FS_EP1_OUT (OTG2_HS_GLOBAL) — OTG_FS out global interrupt
99 OTG_FS_EP1_IN (OTG2_HS_GLOBAL) — OTG_FS in global interrupt
100 OTG_FS_WKUP (OTG2_HS_GLOBAL) — OTG_FS wakeup
101 OTG_FS (OTG1_HS_HOST) — OTG_FS 全局中断
102 DMAMUX1_OV (DMAMUX1) — DMAMUX1 溢出中断
103 HRTIM1_MST (HRTIM_TIMA) — HRTIM1 主定时器中断
104 HRTIM1_TIMA (HRTIM_TIMB) — HRTIM1 定时器 A 中断
105 HRTIM_TIMB (HRTIM_TIMC) — HRTIM1 定时器 B 中断
106 HRTIM1_TIMC (HRTIM_TIMD) — HRTIM1 定时器 C 中断
107 HRTIM1_TIMD (HRTIM_TIME) — HRTIM1 定时器 D 中断
108 HRTIM_TIME (HRTIM_Common) — HRTIM1 定时器 E 中断
109 HRTIM1_FLT (HRTIM_TIMA) — HRTIM1 故障中断
110 DFSDM1_FLT0 (DFSDM) — DFSDM1 滤波器 0 中断
111 DFSDM1_FLT1 (DFSDM) — DFSDM1 滤波器 1 中断
112 DFSDM1_FLT2 (DFSDM) — DFSDM1 滤波器 2 中断
113 DFSDM1_FLT3 (DFSDM) — DFSDM1 滤波器 3 中断
114 SAI3 — SAI3 global interrupt
115 SWPMI1 (SWPMI) — SWPMI 全局中断
116 TIM15 — TIM15 全局中断
117 TIM16 — TIM16 全局中断
118 TIM17 — TIM17 全局中断
119 MDIOS_WKUP (MDIOS) — MDIOS 唤醒中断
120 MDIOS — MDIOS 全局中断
121 JPEG — JPEG 全局中断
122 MDMA — MDMA（主 DMA 控制器）
124 SDMMC (SDMMC1) — SDMMC 全局中断
125 HSEM0 (HSEM) — HSEM 全局中断 1
127 ADC3 — ADC3 全局中断
128 DMAMUX2_OVR (DMAMUX2) — DMAMUX2 溢出中断
{n+129} BDMA_CH{n} (BDMA) (n=0..7) — BDMA 通道 {n} 中断
137 COMP (COMP1) — 比较器 1 和比较器 2
138 LPTIM2 — LPTIM2 timer interrupt
139 LPTIM3 — LPTIM3 全局中断
140 LPTIM4 — LPTIM4 timer interrupt
141 LPTIM5 — LPTIM2 timer interrupt
142 LPUART (LPUART1) — LPUART 全局中断
143 WWDG1_RST (WWDG) — 窗口看门狗中断
144 CRS — 时钟恢复系统全局中断
146 SAI4 — SAI4 全局中断
149 WKUP (DELAY_Block_SDMMC1) — WKUP1 至 WKUP6 引脚
